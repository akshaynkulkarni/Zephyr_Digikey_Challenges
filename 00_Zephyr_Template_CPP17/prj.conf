## CMakeLists.txt
```
cmake_minimum_required(VERSION 3.20.0)

find_package(Zephyr REQUIRED HINTS $ENV{ZEPHYR_BASE})

project(00_Zephyr_Template_CPP17)

target_sources(app PRIVATE src/main.cpp)
```

## prj.conf
```kconfig
#
# C++ Language Support
#
CONFIG_CPP=y
CONFIG_STD_CPP17=y
CONFIG_REQUIRES_FULL_LIBCPP=y
CONFIG_GLIBCXX_LIBCPP=y

#
# Logging
#
CONFIG_LOG=y
CONFIG_LOG_CORE_INIT_PRIORITY=0
CONFIG_LOG_MODE_DEFERRED=y
```

## src/main.cpp
```c
#include <zephyr/kernel.h>
#include <zephyr/logging/log.h>

/* Register the module "main" against logger */
LOG_MODULE_REGISTER(main, CONFIG_LOG_DEFAULT_LEVEL);

/*
 * For same module, to use log from different part of code,
 * declare it through :
 * LOG_MODULE_DECLARE(main , <LOG_LEVEL>);
 */

constexpr uint32_t delay = 1000U; // 1000 ms

extern "C" int main(void) {

  LOG_ERR("This is an example error log");
  LOG_WRN("This is an example warn log");
  LOG_INF("This is an example info log");
  LOG_DBG("This is an example debug log"); // Won't print, as log level is Info.

  while (true) {
    printk("Hello from Zephyr OS!\n");
    k_msleep(delay);
  }

  return 0;
}
```
