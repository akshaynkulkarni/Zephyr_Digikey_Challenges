## CMakeLists.txt
```
cmake_minimum_required(VERSION 3.20.0)

find_package(Zephyr REQUIRED HINTS $ENV{ZEPHYR_BASE})

project(Soln06_Zephyr)

target_include_directories(app PRIVATE inc/)

target_sources(app PRIVATE src/main.cpp src/led.cpp)
```

## prj.conf
```kconfig
#
# C++ Language Support
#
CONFIG_CPP=y
CONFIG_STD_CPP17=y
CONFIG_REQUIRES_FULL_LIBCPP=y
CONFIG_GLIBCXX_LIBCPP=y

# GPIO CONFIG
CONFIG_GPIO=y

# for NRF, to avoid undefined reference for k_malloc()
CONFIG_HEAP_MEM_POOL_SIZE=256

#
# Logging
#
CONFIG_LOG=y
CONFIG_LOG_CORE_INIT_PRIORITY=0
CONFIG_LOG_MODE_DEFERRED=y

#
# General Architecture Options
#
CONFIG_USERSPACE=y
CONFIG_APPLICATION_DEFINED_SYSCALL=y
CONFIG_ASSERT=y
```

## src/main.cpp
```c
#include <zephyr/drivers/gpio.h>
#include <zephyr/kernel.h>
#include <zephyr/logging/log.h>

#include "led.h"

#define LED_DELAY1_DEF (300U)
#define LED_DELAY2_DEF (500U)
#define LED_DELAY3_DEF (234U)
#define UART_DELAY (100U)

// Threads
#if CONFIG_BOARD_ESP
constexpr size_t kThreadStackSize = 4 * 1024;
#else
constexpr size_t kThreadStackSize = 2 * 1024;
#endif

static k_thread thread_0;
static k_thread thread_1;
static k_thread thread_2;

static k_tid_t thread_0_tid;
static k_tid_t thread_1_tid;
static k_tid_t thread_2_tid;

K_KERNEL_STACK_DEFINE(stack_thread_0, kThreadStackSize);
K_THREAD_STACK_DEFINE(stack_thread_1, kThreadStackSize);
K_THREAD_STACK_DEFINE(stack_thread_2, kThreadStackSize);

constexpr int thread_0_prio = 10;
constexpr int thread_1_prio = 10;
constexpr int thread_2_prio = 10;

// Semaphore, Mutex etc

static k_sem param_read_k_semaphore = {NULL};

static k_mutex led_access_mutex = {NULL};

constexpr const gpio_dt_spec thread_led_pin =
    GPIO_DT_SPEC_GET(DT_ALIAS(userled0), gpios);
constexpr const gpio_dt_spec main_led_pin =
    GPIO_DT_SPEC_GET(DT_ALIAS(led0), gpios);

// logging
LOG_MODULE_REGISTER(main, CONFIG_LOG_DEFAULT_LEVEL);
LED_LOGGER_DEFINE(userled0);
LED_LOGGER_DEFINE(led0);

Led thread_led{thread_led_pin, userled0};
Led main_led{main_led_pin, led0};

using led_task_parm_st = struct led_param {
  uint8_t task_no;
  uint32_t blink_rate;
};

static uint32_t blink_count = 0;
static void led_blink_thread(void *param1, void *param2, void *param3) {

  led_task_parm_st const led_params = *((const led_task_parm_st *)param1);
  if (led_params.task_no == 1) {
    k_sem_give(&param_read_k_semaphore);
  }

  LOG_INF("blink rate = %u", led_params.blink_rate);

  while (true) {
    k_mutex_lock(&led_access_mutex, K_FOREVER);
    thread_led.Toggle();
    LOG_INF("Blink count = %u", ++blink_count);
    k_mutex_unlock(&led_access_mutex);
    k_msleep(led_params.blink_rate);
  }
}

extern "C" int main(void) {

  led_task_parm_st led1_params = {.task_no = 1, .blink_rate = LED_DELAY1_DEF};
  led_task_parm_st led2_params = {.task_no = 2, .blink_rate = LED_DELAY2_DEF};
  led_task_parm_st led3_params = {.task_no = 3, .blink_rate = LED_DELAY3_DEF};

  k_sem_init(&param_read_k_semaphore, 1, 1); // Binary Semaphore
  k_mutex_init(&led_access_mutex);           // Mutex Init

  if (thread_led.Init()) {
    return 0;
  }
  if (main_led.Init()) {
    return 0;
  }
  LOG_INF("Starting led Thread 0...");

  thread_0_tid = k_thread_create(
      &thread_0, stack_thread_0, K_KERNEL_STACK_SIZEOF(stack_thread_0),
      led_blink_thread, (void *)&led1_params, nullptr,
      nullptr, thread_0_prio, K_ESSENTIAL, K_NO_WAIT);
  k_sem_take(&param_read_k_semaphore, K_FOREVER);

  LOG_INF("Starting led Thread 1...");

  thread_1_tid = k_thread_create(
      &thread_1, stack_thread_1, K_THREAD_STACK_SIZEOF(stack_thread_1),
      led_blink_thread, (void *)&led2_params, nullptr, nullptr, thread_1_prio,
      K_INHERIT_PERMS, K_NO_WAIT);

  LOG_INF("Starting led Thread 2...");

  thread_2_tid = k_thread_create(
      &thread_2, stack_thread_2, K_THREAD_STACK_SIZEOF(stack_thread_2),
      led_blink_thread, (void *)&led3_params, nullptr, nullptr, thread_2_prio,
      K_INHERIT_PERMS, K_NO_WAIT);

  uint32_t main_count = 0;

  while (true) {
    main_led.Toggle();
    LOG_INF("Blink Led: %u", ++main_count);
    k_msleep(LED_DELAY1_DEF);
  }

  return 0;
}
```

## inc/led.h
```c
#ifndef LED_H
#define LED_H

#include <zephyr/drivers/gpio.h>
#include <zephyr/logging/log.h>
#include <zephyr/logging/log_instance.h>

struct led_instance {
  LOG_INSTANCE_PTR_DECLARE(log);
  uint32_t id;
};

#define LED_LOGGER_DEFINE(_name)                                               \
  LOG_INSTANCE_REGISTER(led_instance, _name, CONFIG_LOG_DEFAULT_LEVEL)         \
  struct led_instance _name = {LOG_INSTANCE_PTR_INIT(log, led_instance, _name)};

class Led {

  constexpr static gpio_dt_spec m_def_pin =
      GPIO_DT_SPEC_GET(DT_ALIAS(led0), gpios);

  gpio_dt_spec m_pin;

  const led_instance& m_logger;

public:
  Led(const gpio_dt_spec &user_pin, const led_instance &logger_instance);
  int Init();
  int DeInit();
  int Toggle();
  int On();
  int Off();
  ~Led() = default;
};

#endif // LED_H
```

## src/led.cpp
```c
#include "led.h"
#include <zephyr/logging/log.h>

LED_LOGGER_DEFINE(m_default_log_instance);

LOG_LEVEL_SET(CONFIG_LOG_DEFAULT_LEVEL);

Led::Led(const gpio_dt_spec &user_pin = m_def_pin,
         const led_instance &logger_instance = m_default_log_instance)
    : m_pin(user_pin), m_logger(logger_instance) {}

int Led::Init() {
  if (!gpio_is_ready_dt(&m_pin)) {
    LOG_INST_ERR(m_logger.log, "Not ready..");
    return -1;
  }

  error_t ret = gpio_pin_configure_dt(&m_pin, GPIO_OUTPUT_INACTIVE);

  if (ret < 0) {
    LOG_INST_ERR(m_logger.log, "Error configuring");
    return ret;
  }
  LOG_INST_INF(m_logger.log, "Initialized..");
  return 0;
}

int Led::DeInit() {
  LOG_INST_INF(m_logger.log, "DeInitialized..");
  return gpio_pin_configure_dt(&m_pin, GPIO_DISCONNECTED);
}

int Led::Toggle() {
  LOG_INST_INF(m_logger.log, "Toggle..");
  return gpio_pin_toggle_dt(&m_pin);
}

int Led::On() {
  LOG_INST_INF(m_logger.log, "Switching ON..");
  return gpio_pin_set_dt(&m_pin, true);
}

int Led::Off() {
  LOG_INST_INF(m_logger.log, "Switching OFF..");
  return gpio_pin_set_dt(&m_pin, false);
}
```

## src/uartpolling.cpp
```c
#include "uartpolling.h"

UartPolling::UartPolling(const ptr_device_const &p_user_port = p_def_port,
                         const uart_config &user_config = def_config)
    : m_port(p_user_port), config(user_config) {}

UartPolling::UartPolling(const ptr_device_const &p_user_port = p_def_port)
    : m_port(p_user_port) {}

int UartPolling::Init() { return uart_configure(m_port, &config); }

int UartPolling::IsReady() { return device_is_ready(m_port); }

int UartPolling::DeInit() {
  uart_rx_disable(m_port);
  return 0;
}

void UartPolling::Write(const unsigned char &buffer) {
  uart_poll_out(m_port, buffer);
}

void UartPolling::Write(const uint16_t &buffer) {
  uart_poll_out_u16(m_port, buffer);
}

int UartPolling::Read(uint16_t &buffer) {
  int ret = uart_poll_in_u16(m_port, &buffer);
  if (ret) {
    // std::cout << "uart: buffer empty" << std::endl;
    buffer = '\0';
  }
  return ret;
}

int UartPolling::Read(unsigned char &buffer) {
  int ret = uart_poll_in(m_port, &buffer);
  if (ret) {
    // std::cout << "uart: buffer empty" << std::endl;
    buffer = '\0';
  }
  return ret;
}
```
